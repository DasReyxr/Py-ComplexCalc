/*
--------- Auf Das  ---------
------- Complex Calc  -------
------- HW Version  --------
-------- 16/12/2025 --------
Pinout LCD ST7735:
 * A3 CS
 * A4 DC
 * A5 SCK
 * A6 RES
 * A7 MOSI
*/
// ------- Main Library -------
#include "stm32f4xx_hal.h"

#include <stdlib.h>
#include <string.h>
// ------- HAL Libraries ---------
#include "HALTecMat4x4.h"
#include "HALConfig.h"
#include "st7735.h"

#include "ComplexGJ.h"
#include "fonts.h"
//#include "testimg.h"

// --------- Function ---------
uint8_t readPad(char *);

// -------- Variables --------

static const uint16_t TestImage [] ={
    0xFF,0xFF,0x3,0x3,0x3,0x3,0x3,0x3,0x3,0x3,0x3,0x3,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0x0
};

// Variables globales de control
uint8_t level = 0 ;

// Buffer
#define BUFFER_SIZE 16
uint8_t index_Var = 0;
char buffer[BUFFER_SIZE];
uint8_t navigating = 0;
// Matriz y tama;o de matriz
uint8_t matSize;
cplx A[N_MAX][N_MAX] = {0};
cplx b[N_MAX] = {0};
cplx x[N_MAX] = {0};

// Variables de control de pantalla
uint8_t needsRedraw = 1;
uint8_t editingReal = 1; // 1 = editando real, 0 = editando imaginario
double real = 0.0, imag = 0.0;
// ----------- Main -----------


void init() {
	HAL_Init();
	SystemClock_Config();
	MX_GPIO_Init();
	MX_SPI1_Init();
	ST7735_Init();
	ST7735_FillScreen(ST7735_BLACK);

	config4x4();

    //const char ready[] = "Ready!\r\n";
    //HAL_UART_Transmit(&huart2, (uint8_t*)ready, sizeof(ready)-1, HAL_MAX_DELAY);
}

int main(void)
{

	init();

	char *keypress = NULL;
	char *endptr;
	uint8_t messageReady = 1;
	// Matriz
	uint8_t colMat = 0, rowMat = 0;
	double real, imag = 0.0;
	memset(buffer, 0, sizeof(buffer));
	while (1){

	switch (level){
    case 0:
        // Dibujar pantalla solo cuando sea necesario
        if(needsRedraw) {
            drawLevel0();
            needsRedraw = 0;
        }
        
        keypress = gotKey();
        messageReady = readPad(keypress);
        
        if(messageReady == 0){
            // Actualizar solo el buffer en pantalla

            break;
        }

        // Conversión a entero
        matSize = (uint8_t)strtol(buffer, &endptr, 10);

        if ((endptr == buffer) || (matSize == 0)) {
            level = 0;
            needsRedraw = 1;
        } else if(matSize > N_MAX) {
            matSize = N_MAX;
        }
        
        if(matSize >= 2 && matSize <= N_MAX) {
        	drawLevel0();
            memset(buffer, 0, sizeof(buffer));
            index_Var = 0;
            colMat = 0;
            rowMat = 0;
            editingReal = 1;
            level = 1;
            needsRedraw = 1;
        }
        break;

    case 1:
        if(needsRedraw) {
            drawLevel1(colMat, rowMat, navigating);
            needsRedraw = 0;
        }
        
        keypress = gotKey();
        messageReady = readPad(keypress);
        
		// Si se presionó una tecla pero no es un mensaje completo
		if(messageReady == 2) {
			// Buffer cambió (se agregó/borró un dígito)
			needsRedraw = 1;
			break;
		}
		
		
		// Si no hay nada en el buffer, permitir navegación
        if(index_Var == 0 && navigating) {
            switch (*keypress){
                case 'W':
                    if(colMat > 0) colMat--;
                    needsRedraw = 1;
                    break;
                case 'B':
                    if(colMat < matSize - 1) colMat++;
                    needsRedraw = 1;
                    break;
                case 'L':
                    if(rowMat > 0) rowMat--;
                    needsRedraw = 1;
                    break;
                case 'R':
                    if(rowMat < matSize) rowMat++;
                    needsRedraw = 1;
                    break;
            }
            break;
        }
        
        // Si hay mensaje (se presionó un número o tecla especial)
        if(messageReady == 1) {
            if(*keypress == '=') {
                if(editingReal) {
                    // Termina ingreso de parte real, pasa a imaginario
                    real = strtod(buffer, &endptr);
                    memset(buffer, 0, sizeof(buffer));
                    index_Var = 0;
                    editingReal = 0;
                    needsRedraw = 1;
                    if(rowMat < matSize) A[colMat][rowMat].r = real;
					else b[colMat].r = real;
                } else {
                    // Termina ingreso de parte imaginaria, guarda y avanza
                    imag = strtod(buffer, &endptr);
                    // Guardar en matriz
                    if(rowMat < matSize) A[colMat][rowMat].i = imag;
					else b[colMat].i =imag;
                    // Reset y avanzar
                    memset(buffer, 0, sizeof(buffer));
                    index_Var = 0;
                    editingReal = 1;
                    real = 0.0;
                    imag = 0.0;
                    // Avanzar a siguiente celda (por COLUMNAS primero)
                    rowMat++;
                    if(rowMat > matSize) {
                        rowMat = 0;
                        colMat++;
                    }
                    // Si terminamos, ir a resolver
                    if(colMat >= matSize) {
                        level = 2;
                    }
                    needsRedraw = 1;
                }
            } else if(*keypress == 'I' && editingReal) {
                // Alternativa: si usas 'I' para terminar real (opcional)
                real = strtod(buffer, &endptr);
                memset(buffer, 0, sizeof(buffer));
                index_Var = 0;
                editingReal = 0;
                needsRedraw = 1;
            }
        }
        break;

    case 2:
        // Resolver el sistema
        int success = solve_complex_system(matSize, A, b, x);
        drawLevel2(success == 0);
        
        // Esperar tecla para volver
        messageReady = 0;
        while(!(messageReady)){
            keypress = gotKey();
            messageReady = readPad(keypress);
        }
        
        // Reset para nuevo sistema
        level = 0;
        memset(buffer, 0, sizeof(buffer));
        index_Var = 0;
        needsRedraw = 1;
        break;

		}
 }}



uint8_t readPad(char *keypress){

    if (!keypress) return 0;
    char key = *keypress;
    // Ignore special value
    if ((unsigned char)keypress == 0x27) return 0;

    // Handle control keys
    if (key == '=') {
        /*if (level < 2) level++;
        if (level == 2) level--;*/
        return 1;
    }
	if (*keypress == '-') {
    // Only allow '-' as the first character in the buffer
    if (index_Var == 0) {
        buffer[index_Var++] = '-';
        return 2;} 
	else return 0; // Ignore if not at start
	}
    if (key == 'T') {
        if (level > 0) level--;
        memset(buffer, 0, sizeof(buffer));
        index_Var = 0;
        return 1;
    }
    if (key == 'D') {
        if (index_Var > 0) {
            index_Var--;
            buffer[index_Var] = 0;
        }
        return 2;
    }
    if (key == 'I') {
        return 1;
    }
    if (key == 'F') {
        navigating ^= 1;
        return 2;
    }

    // Handle numbers and dot
    if ((key >= '0' && key <= '9') || key == '.') {
        if (index_Var < BUFFER_SIZE) {
            buffer[index_Var++] = key;
        }
        return 2;
    }

    // Unknown key
    return 0;
}
